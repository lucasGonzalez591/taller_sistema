## main/Kconfig.projbuild
```kconfig
menu "Example Configuration"

    orsource "$IDF_PATH/examples/common_components/env_caps/$IDF_TARGET/Kconfig.env_caps"

    choice BLINK_LED
        prompt "Blink LED type"
        default BLINK_LED_GPIO
        help
            Select the LED type. A normal level controlled LED or an addressable LED strip.
            The default selection is based on the Espressif DevKit boards.
            You can change the default selection according to your board.

        config BLINK_LED_GPIO
            bool "GPIO"
        config BLINK_LED_STRIP
            bool "LED strip"
    endchoice

    choice BLINK_LED_STRIP_BACKEND
        depends on BLINK_LED_STRIP
        prompt "LED strip backend peripheral"
        default BLINK_LED_STRIP_BACKEND_RMT if SOC_RMT_SUPPORTED
        default BLINK_LED_STRIP_BACKEND_SPI
        help
            Select the backend peripheral to drive the LED strip.

        config BLINK_LED_STRIP_BACKEND_RMT
            depends on SOC_RMT_SUPPORTED
            bool "RMT"
        config BLINK_LED_STRIP_BACKEND_SPI
            bool "SPI"
    endchoice

    config BLINK_GPIO
        int "Blink GPIO number"
        range ENV_GPIO_RANGE_MIN ENV_GPIO_OUT_RANGE_MAX
        default 2
        help
            GPIO conectado al LED integrado de la placa ESP32.
            En la mayoria de placas ESP32-WROOM-32 el LED integrado usa GPIO2.

    config DHT22_GPIO
        int "GPIO conectado al DHT22"
        range ENV_GPIO_RANGE_MIN ENV_GPIO_OUT_RANGE_MAX
        default 4
        help
            GPIO conectado al pin DATA del sensor DHT22.
            Se recomienda una resistencia externa de 4.7k a 10k ohmios entre DATA y 3.3V.

    config BLINK_PERIOD
        int "Blink period in ms"
        range 10 3600000
        default 1000
        help
            Define el periodo de parpadeo en milisegundos.

endmenu

menu "Sensor Network Configuration"

    config SENSOR_WIFI_SSID
        string "Wi-Fi SSID"
        default ""
        help
            Nombre de la red Wi-Fi a la que se conectara el ESP32.

    config SENSOR_WIFI_PASSWORD
        string "Wi-Fi password"
        default ""
        help
            Contrasena de la red Wi-Fi.

    config SENSOR_POST_URL
        string "Temperature endpoint URL"
        default "https://thingsonline.net/api/sensors/temperature"

    config SENSOR_API_KEY
        string "API key"
        default ""
        help
            Clave enviada en el encabezado HTTP x-api-key.

endmenu
```

## sdkconfig.defaults
```kconfig
CONFIG_BLINK_LED_GPIO=y
CONFIG_BLINK_GPIO=2
CONFIG_MBEDTLS_CERTIFICATE_BUNDLE=y
CONFIG_MBEDTLS_CERTIFICATE_BUNDLE_DEFAULT_FULL=y
```
